#include <stm32g0xx_hal.h>
#include <math.h>
#include <stdarg.h>
#include <stdbool.h>
#include <stdint.h>
#include <stdio.h>
#include "../../../testdrive/cli/ekf.h"
#include "../../../testdrive/cli/geom.h"

#define BMI_CS_PIN  GPIO_PIN_3
#define BMI_CS_PORT GPIOA
#define nRF_CS_PIN  GPIO_PIN_7
#define nRF_CS_PORT GPIOA
#define nRF_CE_PIN  GPIO_PIN_11
#define nRF_CE_PORT GPIOA
#define VDDSUB_G_PIN  GPIO_PIN_9
#define VDDSUB_G_PORT GPIOB
#define MOTOR_G_PIN   GPIO_PIN_4
#define MOTOR_G_PORT  GPIOA

// #define RELEASE
#ifndef RELEASE
#define _release_inline
static uint8_t swv_buf[256];
static size_t swv_buf_ptr = 0;
__attribute__ ((noinline, used))
void swv_trap_line()
{
  *(volatile char *)swv_buf;
}
static inline void swv_putchar(uint8_t c)
{
  // ITM_SendChar(c);
  if (c == '\n') {
    swv_buf[swv_buf_ptr >= sizeof swv_buf ?
      (sizeof swv_buf - 1) : swv_buf_ptr] = '\0';
    swv_trap_line();
    swv_buf_ptr = 0;
  } else if (++swv_buf_ptr <= sizeof swv_buf) {
    swv_buf[swv_buf_ptr - 1] = c;
  }
}
static void swv_printf(const char *restrict fmt, ...)
{
  char s[256];
  va_list args;
  va_start(args, fmt);
  int r = vsnprintf(s, sizeof s, fmt, args);
  for (int i = 0; i < r && i < sizeof s - 1; i++) swv_putchar(s[i]);
  if (r >= sizeof s) {
    for (int i = 0; i < 3; i++) swv_putchar('.');
    swv_putchar('\n');
  }
}
#else
#define _release_inline inline
#define swv_printf(...)
#endif

SPI_HandleTypeDef spi1 = { 0 }, spi2 = { 0 };
TIM_HandleTypeDef tim14, tim16, tim17;

#pragma GCC optimize("O3")
static inline void spi1_transmit(uint8_t *data, size_t size)
{
  HAL_SPI_Transmit(&spi1, data, size, 1000); return;
/*
  for (int i = 0; i < size; i++) {
    while (!(SPI1->SR & SPI_SR_TXE)) { }
    SPI1->DR = data[i];
  }
  while (!(SPI1->SR & SPI_SR_TXE)) { }
  while ((SPI1->SR & SPI_SR_BSY)) { }
  // Clear OVR flag
  (void)SPI1->DR;
  (void)SPI1->SR;
*/
}

static inline void spi2_transmit(const uint8_t *data, size_t size)
{
  HAL_SPI_Transmit(&spi2, (uint8_t *)data, size, 1000); return;
}
static inline void spi2_receive(uint8_t *data, size_t size)
{
  for (int i = 0; i < size; i++) data[i] = 0xAA;
  HAL_SPI_Receive(&spi2, data, size, 1000);
}
static _release_inline uint8_t bmi270_read_reg(uint8_t reg)
{
  uint8_t data[2] = {0x80 | reg};
  HAL_GPIO_WritePin(BMI_CS_PORT, BMI_CS_PIN, 0);
  spi2_transmit(data, 1);
  spi2_receive(data, 2);
  HAL_GPIO_WritePin(BMI_CS_PORT, BMI_CS_PIN, 1);
  return data[1];
}
static _release_inline void bmi270_write_reg(uint8_t reg, uint8_t value)
{
  uint8_t data[2] = {reg, value};
  HAL_GPIO_WritePin(BMI_CS_PORT, BMI_CS_PIN, 0);
  spi2_transmit(data, 2);
  HAL_GPIO_WritePin(BMI_CS_PORT, BMI_CS_PIN, 1);
  // 2 µs delay
}
static _release_inline void bmi270_read_burst(uint8_t reg, uint8_t *data, uint32_t len)
{
  HAL_GPIO_WritePin(BMI_CS_PORT, BMI_CS_PIN, 0);
  uint8_t data_byte = {0x80 | reg};
  spi2_transmit(&data_byte, 1);
/*
  // XXX: This works differently from expected – the first actual data byte missing?
  spi2_receive(&data_byte, 1);  // Dummy byte
  swv_printf("[%02x]", (int)data_byte);
  spi2_receive(data, len);
  for (int i = 0; i < len; i++) swv_printf(" (%02x)", (int)data[i]);
*/
  static uint8_t buf[32];
  spi2_receive(buf, len + 1);
  for (int i = 0; i < len; i++) data[i] = buf[i + 1];
  HAL_GPIO_WritePin(BMI_CS_PORT, BMI_CS_PIN, 1);
}
static _release_inline void bmi270_write_burst(const uint8_t *data, uint32_t len)
{
  HAL_GPIO_WritePin(BMI_CS_PORT, BMI_CS_PIN, 0);
  spi2_transmit(data, len);
  HAL_GPIO_WritePin(BMI_CS_PORT, BMI_CS_PIN, 1);
}
static const uint8_t bmi270_config_file[] = {
  0x5E,
  0xc8, 0x2e, 0x00, 0x2e, 0x80, 0x2e, 0x3d, 0xb1, 0xc8, 0x2e, 0x00, 0x2e, 0x80, 0x2e, 0x91, 0x03, 0x80, 0x2e, 0xbc,
  0xb0, 0x80, 0x2e, 0xa3, 0x03, 0xc8, 0x2e, 0x00, 0x2e, 0x80, 0x2e, 0x00, 0xb0, 0x50, 0x30, 0x21, 0x2e, 0x59, 0xf5,
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  0x2e, 0x00, 0xc1
};

static _release_inline void nRF_send_len(const uint8_t *cmd, uint32_t size)
{
  HAL_GPIO_WritePin(nRF_CS_PORT, nRF_CS_PIN, GPIO_PIN_RESET);
  HAL_SPI_Transmit(&spi1, (uint8_t *)cmd, size, 1000);
  HAL_GPIO_WritePin(nRF_CS_PORT, nRF_CS_PIN, GPIO_PIN_SET);
}
#define nRF_send(...) do { \
  uint8_t buf[] = {__VA_ARGS__}; \
  nRF_send_len(buf, sizeof buf); \
} while (0)

static inline uint8_t bit_rev(uint8_t x)
{
  x = (x & 0b00001111) << 4 | (x & 0b11110000) >> 4;
  x = (x & 0b00110011) << 2 | (x & 0b11001100) >> 2;
  x = (x & 0b01010101) << 1 | (x & 0b10101010) >> 1;
  return x;
}

static inline void ble_encode_packet(uint8_t *packet, uint8_t len, uint8_t ch)
{
  // CRC
  uint8_t crc[3] = {0x55, 0x55, 0x55};
  for (uint8_t i = 0; i < len; i++) {
    uint8_t d = packet[i];
    for (uint8_t v = 0; v < 8; v++, d >>= 1) {
      uint8_t t = 0;
      if (crc[0] & 0x80) { t = 1;       } crc[0] <<= 1;
      if (crc[1] & 0x80) { crc[0] |= 1; } crc[1] <<= 1;
      if (crc[2] & 0x80) { crc[1] |= 1; } crc[2] <<= 1;
      if (t != (d & 1)) {
        crc[2] ^= 0x5B;
        crc[1] ^= 0x06;
      }
    }
  }
  packet[len + 0] = bit_rev(crc[0]);
  packet[len + 1] = bit_rev(crc[1]);
  packet[len + 2] = bit_rev(crc[2]);

  // Whiten
  uint8_t whiten_coeff = bit_rev(ch) | 2;
  for (uint8_t i = 0; i < len + 3; i++) {
    for (uint8_t m = 1; m != 0; m <<= 1) {
      if (whiten_coeff & 0x80) {
        whiten_coeff ^= 0x11;
        packet[i] ^= m;
      }
      whiten_coeff <<= 1;
    }
  }

  // Reverse all bits
  for (uint8_t i = 0; i < len + 3; i++)
    packet[i] = bit_rev(packet[i]);
}

static inline int16_t satneg16(int16_t x)
{
  if (x == INT16_MIN) return INT16_MAX;
  return -x;
}

struct filter {
  float i1, i2;
};

static inline float filter_update(
  struct filter *f,
  float th, float thd
) {
  if (th < f->i2 - M_PI) th += M_PI * 2;
  if (th > f->i2 + M_PI) th -= M_PI * 2;
  float x1 = f->i2 - th;
  f->i1 += x1 * 1.f/100;
  const float omega = 24.0f;
  float x2 = 1.0f * omega * f->i1 + 1.414f * omega * x1;
  float x3 = thd - x2;
  f->i2 += x3 * 1.f/100;
  if (f->i2 >  M_PI) f->i2 -= M_PI * 2;
  if (f->i2 < -M_PI) f->i2 += M_PI * 2;
  return f->i2;
}

int main()
{
  HAL_Init();

  // ======== GPIO ========
  __HAL_RCC_GPIOA_CLK_ENABLE();
  __HAL_RCC_GPIOB_CLK_ENABLE();
  GPIO_InitTypeDef gpio_init;

  // SWD (PA13, PA14)
  gpio_init.Pin = GPIO_PIN_13 | GPIO_PIN_14;
  gpio_init.Mode = GPIO_MODE_AF_PP; // Pass over control to AF peripheral
  gpio_init.Alternate = GPIO_AF0_SWJ;
  gpio_init.Pull = GPIO_PULLUP;
  gpio_init.Speed = GPIO_SPEED_FREQ_HIGH;
  HAL_GPIO_Init(GPIOA, &gpio_init);

  // ======== Clocks ========
  RCC_OscInitTypeDef osc_init = { 0 };
  osc_init.OscillatorType = RCC_OSCILLATORTYPE_HSI;
  osc_init.HSIState = RCC_HSI_ON;
  osc_init.PLL.PLLState = RCC_PLL_ON;
  osc_init.PLL.PLLSource = RCC_PLLSOURCE_HSI;
  osc_init.PLL.PLLM = RCC_PLLM_DIV1;  // VCO input 16 MHz (2.66 ~ 16 MHz)
  osc_init.PLL.PLLN = 8;             // VCO output 128 MHz (64 ~ 344 MHz)
  osc_init.PLL.PLLP = RCC_PLLP_DIV2;  // PLLPCLK 64 MHz
  osc_init.PLL.PLLR = RCC_PLLR_DIV2;  // PLLRCLK 64 MHz
  HAL_RCC_OscConfig(&osc_init);

  RCC_ClkInitTypeDef clk_init = { 0 };
  clk_init.ClockType =
    RCC_CLOCKTYPE_SYSCLK |
    RCC_CLOCKTYPE_HCLK |
    RCC_CLOCKTYPE_PCLK1;
  clk_init.SYSCLKSource = RCC_SYSCLKSOURCE_PLLCLK; // 64 MHz
  clk_init.AHBCLKDivider = RCC_SYSCLK_DIV1;
  clk_init.APB1CLKDivider = RCC_HCLK_DIV1;
  HAL_RCC_ClockConfig(&clk_init, FLASH_LATENCY_2);

  HAL_NVIC_SetPriority(SysTick_IRQn, 0, 0);

  gpio_init.Pull = GPIO_NOPULL;
  gpio_init.Speed = GPIO_SPEED_FREQ_HIGH;
  gpio_init.Pin = VDDSUB_G_PIN;
  gpio_init.Mode = GPIO_MODE_OUTPUT_PP;
  HAL_GPIO_Init(VDDSUB_G_PORT, &gpio_init);
  HAL_GPIO_WritePin(VDDSUB_G_PORT, VDDSUB_G_PIN, 0);
  gpio_init.Pin = MOTOR_G_PIN;
  gpio_init.Mode = GPIO_MODE_OUTPUT_PP;
  HAL_GPIO_Init(MOTOR_G_PORT, &gpio_init);
  HAL_GPIO_WritePin(MOTOR_G_PORT, MOTOR_G_PIN, 0);

/*
  for (int i = 0; i < 4; i++) {
    HAL_Delay(500); HAL_GPIO_WritePin(MOTOR_G_PORT, MOTOR_G_PIN, 1);
    HAL_Delay(i < 2 ? 65 : 500); HAL_GPIO_WritePin(MOTOR_G_PORT, MOTOR_G_PIN, 0);
  }
*/
  HAL_Delay(50); HAL_GPIO_WritePin(MOTOR_G_PORT, MOTOR_G_PIN, 1);
  HAL_Delay(50); HAL_GPIO_WritePin(MOTOR_G_PORT, MOTOR_G_PIN, 0);

  // ======== LED Timers ========
  // APB1 = 16 MHz
  // period = 4 kHz = 4000 cycles

  // LED Blue, TIM14 Ch1, PB1
  gpio_init.Pin = GPIO_PIN_1;
  gpio_init.Mode = GPIO_MODE_AF_PP;
  gpio_init.Alternate = GPIO_AF0_TIM14;
  gpio_init.Pull = GPIO_NOPULL;
  gpio_init.Speed = GPIO_SPEED_FREQ_HIGH;
  HAL_GPIO_Init(GPIOB, &gpio_init);
  __HAL_RCC_TIM14_CLK_ENABLE();
  tim14 = (TIM_HandleTypeDef){
    .Instance = TIM14,
    .Init = {
      .Prescaler = 1 - 1,
      .CounterMode = TIM_COUNTERMODE_UP,
      .Period = 4000 - 1,
      .ClockDivision = TIM_CLOCKDIVISION_DIV1,
      .RepetitionCounter = 0,
    },
  };
  HAL_TIM_PWM_Init(&tim14);
  TIM_OC_InitTypeDef tim14_ch1_oc_init = {
    .OCMode = TIM_OCMODE_PWM2,
    .Pulse = 0, // to be filled
    .OCPolarity = TIM_OCPOLARITY_HIGH,
  };
  HAL_TIM_PWM_ConfigChannel(&tim14, &tim14_ch1_oc_init, TIM_CHANNEL_1);
  HAL_TIM_PWM_Start(&tim14, TIM_CHANNEL_1);

  // LED Green, TIM16 Ch1N, PB6
  gpio_init.Pin = GPIO_PIN_6;
  gpio_init.Mode = GPIO_MODE_AF_PP;
  gpio_init.Alternate = GPIO_AF2_TIM16;
  gpio_init.Pull = GPIO_NOPULL;
  gpio_init.Speed = GPIO_SPEED_FREQ_HIGH;
  HAL_GPIO_Init(GPIOB, &gpio_init);
  __HAL_RCC_TIM16_CLK_ENABLE();
  tim16 = (TIM_HandleTypeDef){
    .Instance = TIM16,
    .Init = {
      .Prescaler = 1 - 1,
      .CounterMode = TIM_COUNTERMODE_UP,
      .Period = 4000 - 1,
      .ClockDivision = TIM_CLOCKDIVISION_DIV1,
      .RepetitionCounter = 0,
    },
  };
  HAL_TIM_PWM_Init(&tim16);
  TIM_OC_InitTypeDef tim16_ch1_oc_init = {
    .OCMode = TIM_OCMODE_PWM2,
    .Pulse = 0, // to be filled
    .OCNPolarity = TIM_OCNPOLARITY_HIGH,  // Output is TIM16_CH1N
  };
  HAL_TIM_PWM_ConfigChannel(&tim16, &tim16_ch1_oc_init, TIM_CHANNEL_1);
  HAL_TIMEx_PWMN_Start(&tim16, TIM_CHANNEL_1);

  // LED Red, TIM17 Ch1N PB7
  gpio_init.Pin = GPIO_PIN_7;
  gpio_init.Mode = GPIO_MODE_AF_PP;
  gpio_init.Alternate = GPIO_AF2_TIM17;
  gpio_init.Pull = GPIO_NOPULL;
  gpio_init.Speed = GPIO_SPEED_FREQ_HIGH;
  HAL_GPIO_Init(GPIOB, &gpio_init);
  __HAL_RCC_TIM17_CLK_ENABLE();
  tim17 = (TIM_HandleTypeDef){
    .Instance = TIM17,
    .Init = {
      .Prescaler = 1 - 1,
      .CounterMode = TIM_COUNTERMODE_UP,
      .Period = 4000 - 1,
      .ClockDivision = TIM_CLOCKDIVISION_DIV1,
      .RepetitionCounter = 0,
    },
  };
  HAL_TIM_PWM_Init(&tim17);
  TIM_OC_InitTypeDef tim17_ch1_oc_init = {
    .OCMode = TIM_OCMODE_PWM2,
    .Pulse = 0, // to be filled
    .OCNPolarity = TIM_OCNPOLARITY_HIGH,  // Output is TIM17_CH1N
  };
  HAL_TIM_PWM_ConfigChannel(&tim17, &tim17_ch1_oc_init, TIM_CHANNEL_1);
  HAL_TIMEx_PWMN_Start(&tim17, TIM_CHANNEL_1);

  // ======== SPI ========
  // SPI1
  // SPI1_SCK (PA1 AF0), SPI1_MOSI (PA2 AF0), SPI1_MISO (PA6 AF0)
  gpio_init.Pin = GPIO_PIN_1 | GPIO_PIN_2 | GPIO_PIN_6;
  gpio_init.Mode = GPIO_MODE_AF_PP;
  gpio_init.Alternate = GPIO_AF0_SPI1;
  gpio_init.Pull = GPIO_NOPULL;
  gpio_init.Speed = GPIO_SPEED_FREQ_HIGH;
  HAL_GPIO_Init(GPIOA, &gpio_init);
  HAL_GPIO_WritePin(nRF_CS_PORT, nRF_CS_PIN, GPIO_PIN_SET);
  HAL_GPIO_WritePin(nRF_CE_PORT, nRF_CE_PIN, GPIO_PIN_RESET);
  HAL_Delay(10);

  __HAL_RCC_SPI1_CLK_ENABLE();
  spi1.Instance = SPI1;
  spi1.Init.Mode = SPI_MODE_MASTER;
  spi1.Init.Direction = SPI_DIRECTION_2LINES;
  spi1.Init.CLKPolarity = SPI_POLARITY_LOW; // CPOL = 0
  spi1.Init.CLKPhase = SPI_PHASE_1EDGE;     // CPHA = 0
  spi1.Init.NSS = SPI_NSS_SOFT;
  spi1.Init.FirstBit = SPI_FIRSTBIT_MSB;
  spi1.Init.TIMode = SPI_TIMODE_DISABLE;
  spi1.Init.CRCCalculation = SPI_CRCCALCULATION_DISABLE;
  spi1.Init.DataSize = SPI_DATASIZE_8BIT;
  spi1.Init.BaudRatePrescaler = SPI_BAUDRATEPRESCALER_8;  // APB / 8 = 8 MHz
  HAL_SPI_Init(&spi1);
  __HAL_SPI_ENABLE(&spi1);

  // nRF24L01+ CS, CE
  gpio_init.Pin = nRF_CS_PIN | nRF_CE_PIN;
  gpio_init.Mode = GPIO_MODE_OUTPUT_PP;
  gpio_init.Pull = GPIO_NOPULL;
  gpio_init.Speed = GPIO_SPEED_FREQ_HIGH;
  HAL_GPIO_Init(nRF_CS_PORT, &gpio_init);

  // Set up nRF24L01+
  nRF_send(0x20, 0x72); // CONFIG: Disable IRQ and CRC, power up
  nRF_send(0x21, 0x00); // EN_AA: Disable auto ack.
  nRF_send(0x22, 0x00); // EN_RXADDR: Disable RX completely
  nRF_send(0x23, 0x02); // SETUP_AW: 4-byte address
  nRF_send(0x24, 0x00); // SETUP_RETR: Disable auto restransmission
  nRF_send(0x26, 0x06); // RF_SETUP: 1 Mbps, 0 dBm
  nRF_send(0x27, 0x70); // STATUS: Clear status flags
  nRF_send(0x31, 32);   // RX_PW_P0: Pipe 0 payload length 32 bytes
  nRF_send(0x22, 0x01); // EN_RXADDR: Enable RX on pipe 0
  nRF_send(0x2A, bit_rev(0x8E), bit_rev(0x89), bit_rev(0xBE), bit_rev(0xD6));
    // RX_ADDR_P0: Set pipe 0 receive address
  nRF_send(0x30, bit_rev(0x8E), bit_rev(0x89), bit_rev(0xBE), bit_rev(0xD6));
    // TX_ADDR: Set transmit address

  // Read register 0x06 (RF_SETUP)
  HAL_GPIO_WritePin(nRF_CS_PORT, nRF_CS_PIN, GPIO_PIN_RESET);
  uint8_t spi_tx[2] = {0x06, 0x00};
  uint8_t spi_rx[2];
  HAL_SPI_TransmitReceive(&spi1, spi_tx, spi_rx, 2, 1000);
  HAL_GPIO_WritePin(nRF_CS_PORT, nRF_CS_PIN, GPIO_PIN_SET);
  swv_printf("nRF24L01+ received status %02x %02x\n", spi_rx[0], spi_rx[1]);
  if (spi_rx[0] != 0x0E || spi_rx[1] != 0x06) {
    // Error? Try a reset
    for (int i = 0; i < 11; i++) {
      TIM17->CCR1 = 4000 * (i % 2);
      HAL_Delay(120);
    }
    HAL_Delay(500);
    NVIC_SystemReset();
  }

  TIM14->CCR1 = 4000;
  HAL_Delay(200);
  TIM14->CCR1 = 0;

  // SPI2
  // SPI2_SCK (PA0 AF0), SPI2_MOSI (PA10 AF0)
  gpio_init.Pin = GPIO_PIN_0 | GPIO_PIN_10;
  gpio_init.Mode = GPIO_MODE_AF_PP;
  gpio_init.Alternate = GPIO_AF0_SPI2;
  gpio_init.Pull = GPIO_NOPULL;
  gpio_init.Speed = GPIO_SPEED_FREQ_HIGH;
  HAL_GPIO_Init(GPIOA, &gpio_init);
  // Remap pin 17 (default PA12) to PA10
  __HAL_RCC_SYSCFG_CLK_ENABLE();
  SYSCFG->CFGR1 |= SYSCFG_REMAP_PA12;

  __HAL_RCC_SPI2_CLK_ENABLE();
  spi2.Instance = SPI2;
  spi2.Init.Mode = SPI_MODE_MASTER;
  spi2.Init.Direction = SPI_DIRECTION_1LINE;
  spi2.Init.CLKPolarity = SPI_POLARITY_LOW; // CPOL = 0
  spi2.Init.CLKPhase = SPI_PHASE_1EDGE;     // CPHA = 0
  spi2.Init.NSS = SPI_NSS_SOFT;
  spi2.Init.FirstBit = SPI_FIRSTBIT_MSB;
  spi2.Init.TIMode = SPI_TIMODE_DISABLE;
  spi2.Init.CRCCalculation = SPI_CRCCALCULATION_DISABLE;
  spi2.Init.DataSize = SPI_DATASIZE_8BIT;
  spi2.Init.BaudRatePrescaler = SPI_BAUDRATEPRESCALER_64;  // APB / 64 = 1 MHz
  HAL_SPI_Init(&spi2);
  __HAL_SPI_ENABLE(&spi2);

  // BMI270 CS
  gpio_init.Pin = BMI_CS_PIN;
  gpio_init.Mode = GPIO_MODE_OUTPUT_PP;
  gpio_init.Pull = GPIO_NOPULL;
  gpio_init.Speed = GPIO_SPEED_FREQ_HIGH;
  HAL_GPIO_Init(BMI_CS_PORT, &gpio_init);

  HAL_GPIO_WritePin(BMI_CS_PORT, BMI_CS_PIN, 0); HAL_Delay(1);
  HAL_GPIO_WritePin(BMI_CS_PORT, BMI_CS_PIN, 1); HAL_Delay(1);
  bmi270_read_reg(0x00);
  bmi270_write_reg(0x7E, 0xB6); // Soft reset
  HAL_Delay(1);

  HAL_GPIO_WritePin(BMI_CS_PORT, BMI_CS_PIN, 0); HAL_Delay(1);
  HAL_GPIO_WritePin(BMI_CS_PORT, BMI_CS_PIN, 1); HAL_Delay(1);
  bmi270_read_reg(0x00);
  bmi270_write_reg(0x6B, 0x01); // IF_CONF.spi3 = 1
  HAL_Delay(1);
  uint8_t chip_id = bmi270_read_reg(0x00);
  swv_printf("BMI270 chip ID = 0x%02x\n", (int)chip_id);

  bmi270_write_reg(0x7C, 0x00);
  HAL_Delay(1);
  bmi270_write_reg(0x59, 0x00);
  bmi270_write_burst(bmi270_config_file, sizeof bmi270_config_file);
  bmi270_write_reg(0x59, 0x01);
  HAL_Delay(150);

  // INTERNAL_STATUS
  uint8_t init_status = bmi270_read_reg(0x21) & 0xF;
  if (init_status == 0x1) {
    swv_printf("BMI270 init ok\n");
  } else {
    swv_printf("BMI270 init status 0x%02x\n", (int)init_status);
  }

if (0) {
  // EKF testrun
  float x[5] = {40, 1, 0, 1, 0};
  float P[5][5] = {
    {30, 0, 0, 0, 0},
    {0, 1, 0, 0, 0},
    {0, 0, 4, 0, 0},
    {0, 0, 0, 1, 0},
    {0, 0, 0, 0, 4},
  };
  const float z[][2] = {
  {-0.30363700,0.15020664}, {-0.30631390,0.23414357}, {-0.38538748,0.23246633}, {-0.60523939,0.19448967}, {-0.57978481,0.28296620}, {-0.50962692,0.32203233}, {-0.24314955,0.30328578}, {-0.12464703,0.28733385}, {-0.10175940,0.22583233}, {-0.11645509,0.18484612}, {-0.13042359,0.06592835}, {-0.11888476,0.02425108}, {0.09917477,-0.29184744}, {0.19101466,-0.40515721}, {0.14989164,-0.39028764}, {0.14948493,-0.47371718}, {0.38135502,-0.71502864}, {0.38196054,-0.72479922}, {0.17213143,-0.48575068}, {0.32378760,-0.51375544}, {0.35252827,-0.48075166}, {0.19650212,-0.30821061}, {0.11248349,-0.20600942}, {0.02866993,-0.04447396}, {0.01317717,0.05961587}, {-0.03961469,0.10225092}, {-0.24324547,0.14320348}, {-0.39089668,0.16226968}, {-0.49451840,0.26791102}, {-0.39591488,0.42068666}, {-0.57746482,0.45009291}, {-0.56653476,0.48279351}, {-0.43490672,0.56886917}, {-0.29006797,0.61037761}, {-0.24318063,0.57972658}, {-0.29184777,0.48923224}, {-0.13847764,0.38742971}, {0.04041527,0.26320687}, {0.04127733,0.10215056}, {-0.06463777,-0.13701807}, {-0.06478415,-0.24504828}, {0.07744804,-0.43994418}, {0.18473396,-0.49606803}, {0.23622359,-0.51487195}, {0.20895399,-0.53060424}, {0.04783802,-0.60734791}, {0.07254527,-0.65975434}, {0.33131307,-0.63892496}, {0.23582080,-0.56343132}, {0.18280277,-0.52789599}, {0.17084940,-0.39010203}, {0.22951111,-0.34484938}, {-0.03699742,-0.05722602}, {-0.18140292,0.07026660}, {-0.23760802,0.23089249}, {-0.26650369,0.27747458}, {-0.35925886,0.25081539}, {-0.54818219,0.32800651}, {-0.49263412,0.54044920}, {-0.45010486,0.53931147}, {-0.42285594,0.47045824}, {-0.40931016,0.41767019}, {-0.31408066,0.49478045}, {-0.19228007,0.33718568}, {-0.13029847,0.11787967}, {0.00030557,-0.01708557}, {0.09615028,-0.11241873}, {0.10723688,-0.18130611}, {0.09115545,-0.40148115}, {0.10925370,-0.50074095}, {0.22120041,-0.53001130}, {0.24110641,-0.53153294}, {0.19485494,-0.61806041}, {0.26380000,-0.57514453}, {0.32951549,-0.49386808}, {0.36785287,-0.38978645}, {0.27860692,-0.32586765}, {0.16321766,-0.22125651}, {0.14411390,-0.02328617}, {0.10326388,0.04643371}, {-0.05306170,0.07792979}, {-0.16220190,0.03928601}, {-0.28640622,0.02047032}, {-0.36345616,0.10877029}, {-0.38800007,0.24996781}, {-0.38978842,0.28373000}, {-0.49033135,0.24924687}, {-0.57866776,0.25950021}, {-0.54379392,0.35218859}, {-0.42451590,0.46109298}, {-0.39415097,0.33890814}, {-0.38060138,0.28842184}, {-0.28590396,0.30008286}, {-0.08202089,0.20807067}, {-0.03129153,-0.01776044}, {0.00363588,-0.13705035}, {0.03860929,-0.22180936}, {0.10247357,-0.29882747}, {0.25515100,-0.35688379}, {0.28301239,-0.39605173}, {0.25249657,-0.55486429}, {0.28954354,-0.61700886}, {0.38411996,-0.63879788}, {0.50175029,-0.57304406}, {0.47225413,-0.56493580}, {0.31840721,-0.49044207}, {0.38167441,-0.35712361}, {0.39894086,-0.29362521}, {0.28076777,-0.18121380}, {0.19551904,-0.14407739}, {0.08652972,-0.10651992}, {0.00696266,-0.07358578}, {-0.08073533,-0.02269388}, {-0.13419254,0.02019654}, {-0.19816054,0.06971467}, {-0.32934648,0.10508676}, {-0.60675406,0.22733434}, {-0.59402305,0.34192026}, {-0.60042399,0.37047657}, {-0.57027417,0.40000844}, {-0.47316226,0.45733723}, {-0.28037795,0.36443633}, {-0.23900886,0.33897769}, {-0.08940041,0.16992749}, {-0.05113379,0.13880728}, {0.04408585,0.00884814}, {0.08021747,-0.09190452}, {0.07632238,-0.27932578}, {0.07687984,-0.36379793}, {0.14932121,-0.53209001}, {0.20739354,-0.57266647}, {0.26349905,-0.60401529}, {0.27272630,-0.61691296}, {0.21310301,-0.66326547}, {0.26655236,-0.69546729}, {0.32850072,-0.55719531}, {0.27541852,-0.47940826}, {0.21190131,-0.37638173}, {0.23933363,-0.26524806}, {0.22822015,-0.17975539}, {0.08922987,-0.04040584}, {-0.19354078,0.09725228}, {-0.23579903,0.10137463}, {-0.35789549,0.18945079}, {-0.37153977,0.20865141}, {-0.46202052,0.28290319}, {-0.58196497,0.37351170}, {-0.58380395,0.45924917}, {-0.48389462,0.54106849}, {-0.41054195,0.51467806}, {-0.18860297,0.46755669}, {-0.12691370,0.39276743}, {-0.07269418,0.21749605}, {-0.05407866,0.14032799}, {-0.00177021,-0.02923136}, {0.07781677,-0.22543624}, {0.10078407,-0.30397841}, {0.11617984,-0.45961538}, {0.11907056,-0.51410371}, {0.14416645,-0.55096042}, {0.16229665,-0.55490148}, {0.20999256,-0.61850160}, {0.22545470,-0.62294483}, {0.22895981,-0.62584955}, {0.25350642,-0.58785832}, {0.25481009,-0.50098115}, {0.26106539,-0.42437875}, {0.16678701,-0.24623549}, {0.14747514,-0.16875063}, {0.04376304,-0.02576557}, {-0.03572749,0.04033025}, {-0.20537177,0.11047387}, {-0.34392333,0.15153377}, {-0.39305353,0.17609900}, {-0.43212369,0.27922127}, {-0.43742117,0.33013046}, {-0.46694326,0.37928015}, {-0.52657193,0.42468476}, {-0.47186950,0.46062526}, {-0.32938012,0.48099685}, {-0.26597926,0.45363292}, {-0.22789073,0.38639119}, {-0.21272177,0.37370026}, {-0.12697290,0.26302162}, {-0.10216182,0.24373704}, {-0.02481217,0.13768460}, {0.02312215,-0.00289285}, {0.06858554,-0.13760448}, {0.07081611,-0.25226060}, {0.11630938,-0.35172278}, {0.14294705,-0.36627078}, {0.14865175,-0.37146181}, {0.20580271,-0.50480747}, {0.26219732,-0.56211811}, {0.27820250,-0.53524119}, {0.25343242,-0.43453878}, {0.21745415,-0.39422315}, {0.20855525,-0.37974143}, {0.20256746,-0.36685812}, {0.18957238,-0.30061865}
  };
  int n = sizeof z / sizeof z[0];
  swv_printf("start %u\n", HAL_GetTick());
  for (int i = 0; i < n; i++) {
    ekf_step(x, P, z[i]);
  }
  swv_printf("end %d (processed %d) %u\n", (int)(x[2] * 1000), n, HAL_GetTick());
  // start 544
  // end 1366 (processed 200) 918
  while (1) { }
}

  // Normal mode
  bmi270_write_reg(0x7D, 0b0110); // PWR_CTRL.gyr_en = 1, .acc_en = 1
  bmi270_write_reg(0x40, 0xA8);   // ACC_CONF
  bmi270_write_reg(0x41, 0x01);   // ACC_RANGE: +/-4g
  bmi270_write_reg(0x42, 0xA9);   // GYR_CONF
  bmi270_write_reg(0x43, 0x00);   // GYR_RANGE: +/-2000dps
  HAL_Delay(10);

  bmi270_write_reg(0x6B, 0x21);   // IF_CONF.aux_en = 1
  bmi270_write_reg(0x7D, 0b0110); // PWR_CTRL.aux_en = 0
  bmi270_write_reg(0x4B, 0x30 << 1);  // AUX_DEV_ID
  bmi270_write_reg(0x4C, 0b10001111);
    // AUX_IF_CONF
    //   .aux_rd_burst = 0x3 (length 8)
    //   .man_rd_burst = 0x3 (length 8)
    //   .aux_manual_en = 1
  // Write to ODR (0x1A), value 100
  bmi270_write_reg(0x4F, 100);
  bmi270_write_reg(0x4E, 0x1A);
  HAL_Delay(1);
  // Write to Internal Control 0 (0x1B), value 0xA1 (Cmm_freq_en, Auto_SR_en, Take_meas_M)
  bmi270_write_reg(0x4F, 0xA1);
  bmi270_write_reg(0x4E, 0x1B);
  HAL_Delay(1);
  // Write to Internal Control 2 (0x1D), value 0x10 (Cmm_en)
  bmi270_write_reg(0x4F, 0x10);
  bmi270_write_reg(0x4E, 0x1D);
  HAL_Delay(1);

  bmi270_write_reg(0x7D, 0b0111); // PWR_CTRL.aux_en = 1
  bmi270_write_reg(0x4D, 0x00);   // AUX_RD_ADDR
  bmi270_write_reg(0x4C, 0b00001111); // AUX_IF_CONF.aux_manual_en = 0
  HAL_Delay(10);

  while (0) {
    uint8_t data[32] = {1, 2, 3, 4, 5, 6, 7, 8};
    bmi270_read_burst(0x04, data, 8);
    uint16_t aux_x = ((uint16_t)data[0] << 8) | data[1];
    uint16_t aux_y = ((uint16_t)data[2] << 8) | data[3];
    uint16_t aux_z = ((uint16_t)data[4] << 8) | data[5];
    uint16_t aux_r = ((uint16_t)data[6] << 8) | data[7];
    swv_printf("aux = %04x %04x %04x %04x\n",
      (unsigned)aux_x, (unsigned)aux_y, (unsigned)aux_z, (unsigned)aux_r);
    HAL_Delay(10);
  }

  // Signal processing
  quat q_ref = (quat){0, 0, 0, 1};
  float m_tfm[3][3] = {{1, 0, 0}, {0, 1, 0}, {0, 0, 1}};
  vec3 m_cen = (vec3){0, 0, 0};
  float ekf_x[5] = {10, 1, 0, 1, 0};
  float ekf_P[5][5] = {
    {5, 0, 0, 0, 0},
    {0, 1, 0, 0, 0},
    {0, 0, 4, 0, 0},
    {0, 0, 0, 1, 0},
    {0, 0, 0, 0, 4},
  };

  vec3 acc_history[300];
  int acc_ptr = 0;

  // ======== Main loop ========

  struct proceed_t {
    struct proceed_t (*fn)(void);
    int wait;
  };

  int16_t mag_out[3], acc_out[3], gyr_out[3];
  int32_t music_phase;

  struct proceed_t read_bmi270_and_update() {
    uint8_t data[24];
    bmi270_read_burst(0x04, data, 23);
    // for (int i = 0; i < 23; i++) swv_printf("%02x%c", (int)data[i], i == 22 ? '\n' : ' ');
    // Assumes little endian
    mag_out[2] = satneg16(((int16_t)((int8_t)data[0] << 8) | data[1]) + 0x8000);
    mag_out[0] =         (((int16_t)((int8_t)data[2] << 8) | data[3]) + 0x8000);
    mag_out[1] = satneg16(((int16_t)((int8_t)data[4] << 8) | data[5]) + 0x8000);
    acc_out[2] =          *( int16_t *)(data +  8);
    acc_out[0] = satneg16(*( int16_t *)(data + 10));
    acc_out[1] = satneg16(*( int16_t *)(data + 12));
    gyr_out[2] =          *( int16_t *)(data + 14);
    gyr_out[0] = satneg16(*( int16_t *)(data + 16));
    gyr_out[1] = satneg16(*( int16_t *)(data + 18));
    data[23] = 0;
    uint32_t time = *(uint32_t *)(data + 20);
    // Gyroscope calibration
    int8_t gyr_cas = ((int8_t)bmi270_read_reg(0x3C) << 1) >> 1;
    gyr_out[0] -= ((uint32_t)gyr_cas * gyr_out[2]) >> 9;

    if (!(
      (mag_out[0] != 0x7fff || mag_out[1] != 0x7fff || mag_out[2] != 0x7fff)
      && (acc_out[0] != 0x0000 || acc_out[1] != 0x0000 || acc_out[2] != 0x0000
       || gyr_out[0] != 0x0000 || gyr_out[1] != 0x0000 || gyr_out[2] != 0x0000)
    ))
      // Ignoring invalid data at startup
      return (struct proceed_t){read_bmi270_and_update, 10};

    vec3 acc = (vec3){(float)acc_out[0], (float)acc_out[1], (float)acc_out[2]};
    vec3 gyr = (vec3){(float)gyr_out[0], (float)gyr_out[1], (float)gyr_out[2]};
    vec3 mag = (vec3){(float)mag_out[0], (float)mag_out[1], (float)mag_out[2]};
    float magScale = 2.f / 1024;  // unit = 0.5 G = 0.05 mT ≈ geomagnetic field
    mag = vec3_scale(mag, magScale);

    // In calibration phase?
    if (acc_ptr < 300) {
      acc_history[acc_ptr++] = acc;
      if (acc_ptr == 300) {
        // Check average distance
        vec3 acc_avg = (vec3){ 0 };
        for (int i = 0; i < 300; i++)
          acc_avg = vec3_add(acc_avg, acc_history[i]);
        acc_avg = vec3_scale(acc_avg, 1.0f / 300);
        float dist = 0;
        for (int i = 0; i < 300; i++)
          dist += vec3_distsq(acc_avg, acc_history[i]);
        dist /= (300UL * 8192 * 8192);  // 8192 counts = 1g
        // swv_printf("%05d\n", (int)(dist * 10000));
        if (dist > 0.1) {
          // Retry
          TIM17->CCR1 = 400;
          for (int i = 0; i < 200; i++)
            acc_history[i] = acc_history[i + 100];
          acc_ptr = 200;
          HAL_Delay(100);
          TIM17->CCR1 = 0;
        } else {
          // Calibrated!
          q_ref = rot_from_endpoints(acc_avg, (vec3){0, 0, 1});
          TIM17->CCR1 = 400;
          TIM16->CCR1 = 400;
        }
      }
    }

    vec3 acc_raw = acc;
    vec3 gyr_raw = gyr;
    vec3 mag_raw = mag;
    acc = quat_rot(q_ref, acc_raw);
    gyr = quat_rot(q_ref, gyr_raw);
    mag = quat_rot(q_ref, mag_raw);
    mag = vec3_transform(m_tfm, vec3_diff(mag, m_cen));
    vec3 mag_upright_g = quat_rot(rot_from_endpoints(acc, (vec3){0, 0, 1}), mag);

    float xy_ori_d = gyr.z / (16.384 * 180) * M_PI;
    float xy_ori = -atan2f(mag_upright_g.y, mag_upright_g.x);
    static struct filter xy_f = { 0 };
    float xy_ori_filtered = filter_update(&xy_f, xy_ori, xy_ori_d);

    vec3 gyr_calibrated =
      vec3_scale(vec_rot(gyr, (vec3){0, 0, 1}, xy_ori_filtered), 1.f / (16.384 * 360));
    /* swv_printf("EKF step %6d %6d | gyr %6d %6d\n",
      (int)(gyr_calibrated.x * 100000), (int)(gyr_calibrated.y * 100000),
      (int)(gyr.x / (16.384 * 360) * 100000),
      (int)(gyr.y / (16.384 * 360) * 100000)); */
    float z[2] = {gyr_calibrated.x, gyr_calibrated.y};
    ekf_step(ekf_x, ekf_P, z);

    float ω = ekf_x[0];
    float A = ekf_x[1];
    float θ = ekf_x[2];
    float B = ekf_x[3];
    float ϕ = ekf_x[4];
    float δ = atan2(A*A + B*B * cosf(2*ϕ), -B*B * sinf(2*ϕ));
    float cen_phase = -0.5 * δ + 0.25 * M_PI;
    /* swv_printf("%08x %08x %07d\n",
      *(int *)&cen_phase,
      *(int *)&θ,
      (int)((cen_phase - θ) * 1000)); */
    music_phase = (int32_t)(fmodf(cen_phase - θ, M_PI * 2) * 1000000);

  /*
  #define clamp(_x, _a, _b) ((_x) < (_a) ? (_a) : (_x) > (_b) ? (_b) : (_x))
    TIM17->CCR1 = (HAL_GetTick() % 2048 <= 50 && (HAL_GetTick() / 6144) % 3 != 1) ? 300 : 0;
    TIM16->CCR1 = (HAL_GetTick() % 2048 <= 50 && (HAL_GetTick() / 6144) % 3 != 0) ? 300 : 0;
    TIM14->CCR1 = 0;
  */

    return (struct proceed_t){read_bmi270_and_update, 10};
  }

  static const uint8_t nrf_ch[3] = { 2, 26, 80};
  static const uint8_t ble_ch[3] = {37, 38, 39};
  static uint8_t cur_ch = 2;
  auto struct proceed_t tx_nRF_part_1();
  auto struct proceed_t tx_nRF_part_2();
  struct proceed_t tx_nRF_part_1() {
    cur_ch = (cur_ch + 1) % 3;

    uint8_t nRF_cmd_buf[33];
    uint8_t *buf = nRF_cmd_buf + 1;
    uint8_t p = 0;
    // PDU - Protocol Data Unit
    // AD - Advertising Data
    // For assigned numbers, see https://www.bluetooth.com/specifications/an/
    // PDU header
    buf[p++] = 0x42;  // Type: ADV_NONCONN_IND; TxAdd is random
    buf[p++] = 0;     // Payload length, to be filled
    // PDU payload
    buf[p++] = 0xF9;  // Address (reversed)
    buf[p++] = 0xE9;
    buf[p++] = 0x33;
    buf[p++] = 0x74;
    buf[p++] = 0xD0;
    buf[p++] = 0xFD;
  /*
    buf[p++] = 4;     // AD length
    buf[p++] = 0x08;  // Type: Shortened Local Name
    buf[p++] = 'M';
    buf[p++] = 'l';
    buf[p++] = 't';
  */
    buf[p++] = 20;    // AD length
    buf[p++] = 0xFF;  // Type: Manufacturer Specific Data
  /*
    buf[p++] = 0xFF;
    buf[p++] = 0xFF;
  */
  /*
    static uint16_t timestamp = 0xAA00;
    timestamp++;
    buf[p++] = timestamp >> 8;
    buf[p++] = timestamp & 0xFF;
  */
  /*
    for (int i = 0; i < 3; i++) {
      buf[p++] = mag_out[i] >> 8;
      buf[p++] = mag_out[i] & 0xFF;
    }
  */
    buf[p++] = (music_phase >> 24) & 0xFF;
    buf[p++] = (music_phase >> 16) & 0xFF;
    buf[p++] = (music_phase >>  8) & 0xFF;
    buf[p++] = (music_phase >>  0) & 0xFF;
  /*
    int16_t value_B = (int16_t)(ekf_x[3] * 10000);
    buf[p++] = (value_B >> 8) & 0xFF;
    buf[p++] = (value_B >> 0) & 0xFF;
  */
    int16_t value_A = (int16_t)(ekf_x[1] * 10000);
    buf[p++] = (value_A >> 8) & 0xFF;
    buf[p++] = (value_A >> 0) & 0xFF;
  /*
    for (int i = 0; i < 3; i++) {
      buf[p++] = acc_out[i] >> 8;
      buf[p++] = acc_out[i] & 0xFF;
    }
  */
    int16_t value_omega = (int16_t)(ekf_x[0] * 1000);
    buf[p++] = (value_omega >> 8) & 0xFF;
    buf[p++] = (value_omega >> 0) & 0xFF;
    int16_t value_theta = (int16_t)(ekf_x[2] * 1000);
    buf[p++] = (value_theta >> 8) & 0xFF;
    buf[p++] = (value_theta >> 0) & 0xFF;
    int16_t value_phi = (int16_t)(ekf_x[4] * 1000);
    buf[p++] = (value_phi >> 8) & 0xFF;
    buf[p++] = (value_phi >> 0) & 0xFF;
    for (int i = 0; i < 3; i++) {
      buf[p++] = gyr_out[i] >> 8;
      buf[p++] = gyr_out[i] & 0xFF;
    }
    static int idx = 0;
    buf[p++] = "Mlt"[(idx = (idx + 1) % 3)];
    buf[1] = p - 2;   // Payload length

    // Encode packet
    ble_encode_packet(buf, p, ble_ch[cur_ch]);

    nRF_send(0x25, nrf_ch[cur_ch]); // RF_CH: Set channel
    nRF_send(0x27, 0x70); // STATUS: Clear status flags
    nRF_send(0xE1); // FLUSH_TX
    nRF_send(0xE2); // FLUSH_RX
    nRF_cmd_buf[0] = 0xA0;  // W_TX_PAYLOAD
    nRF_send_len(nRF_cmd_buf, p + 4);
    HAL_GPIO_WritePin(nRF_CE_PORT, nRF_CE_PIN, GPIO_PIN_SET);
    return (struct proceed_t){tx_nRF_part_2, 2};
  }
  struct proceed_t tx_nRF_part_2() {
    HAL_GPIO_WritePin(nRF_CE_PORT, nRF_CE_PIN, GPIO_PIN_RESET);
    return (struct proceed_t){tx_nRF_part_1, 4};
  }

  struct task_t {
    struct proceed_t (*fn)(void);
    uint32_t next_tick;
  };
  uint32_t cur_tick = HAL_GetTick();
  struct task_t task_pool[2] = {
    {read_bmi270_and_update, cur_tick},
    {tx_nRF_part_1, cur_tick},
  };
  while (1) {
    uint32_t cur_tick = HAL_GetTick();
    int32_t soonest_diff = INT32_MAX;
    int soonest_index = -1;
    for (int i = 0; i < 2; i++) {
      int32_t diff = (int32_t)(task_pool[i].next_tick - cur_tick);
      if (diff < soonest_diff) {
        soonest_diff = diff;
        soonest_index = i;
      }
    }
    if (soonest_diff <= 0) {
      // Execute task
      struct proceed_t result = task_pool[soonest_index].fn();
      task_pool[soonest_index].fn = result.fn;
      task_pool[soonest_index].next_tick = cur_tick + result.wait;
    } else {
      HAL_PWR_EnterSLEEPMode(PWR_MAINREGULATOR_ON, PWR_SLEEPENTRY_WFI);
    }
  }
}

void SysTick_Handler()
{
  HAL_IncTick();
  HAL_SYSTICK_IRQHandler();
}
